## drivers/soc/oplus/dfr/Kconfig
```kconfig
# SPDX-License-Identifier: GPL-2.0-only
# Copyright (C) 2018-2022 Oplus. All rights reserved.

#ifdef OPLUS_FEATURE_DUMP_REASON
source "drivers/soc/oplus/dfr/qcom/dump_device_info/Kconfig"
#endif /* OPLUS_FEATURE_DUMP_REASON */

#ifdef OPLUS_FEATURE_DUMP_REASON
source "drivers/soc/oplus/dfr/qcom/dump_reason/Kconfig"
#endif /* OPLUS_FEATURE_DUMP_REASON */
#
#ifdef OPLUS_FEATURE_HUNG_TASK_ENHANCE
source "drivers/soc/oplus/dfr/common/hung_task_enhance/Kconfig"
#endif /* OPLUS_FEATURE_HUNG_TASK_ENHANCE */

#ifdef OPLUS_FEATURE_SAUPWK
source "drivers/soc/oplus/dfr/common/oplus_saupwk/Kconfig"
#endif /* OPLUS_FEATURE_SAUPWK */

#ifdef OPLUS_FEATURE_THEIA
source "drivers/soc/oplus/dfr/common/theia/Kconfig"
#endif /* OPLUS_FEATURE_THEIA */

#ifdef OPLUS_FEATURE_INIT_WATCHDOG
source "drivers/soc/oplus/dfr/common/init_watchdog/Kconfig"
#endif /* OPLUS_FEATURE_INIT_WATCHDOG */

#ifdef OPLUS_FEATURE_KEYEVENT_HANDLER
source "drivers/soc/oplus/dfr/common/keyevent_handler/Kconfig"
#endif /* OPLUS_FEATURE_KEYEVENT_HANDLER */

#ifdef OPLUS_FEATURE_COMBKEY_MONITOR
source "drivers/soc/oplus/dfr/common/combkey_monitor/Kconfig"
#endif /* OPLUS_FEATURE_COMBKEY_MONITOR */

#ifdef CONFIG_OPLUS_FEATURE_FAULT_INJECT
source "drivers/soc/oplus/dfr/fault_inject/Kconfig"
#endif /*CONFIG_OPLUS_FEATURE_FAULT_INJECT*/
```
